// Due Libraries
#include <DueTimer.h>
#include <Wire.h>

// Gloabl Data
const uint8_t MCP4725_ADDR = 0x60;
float freq = 1000;
float Ts = 1/freq;
double volt;
volatile int volt_write;
uint16_t sample = 0;

const int buttonPin = 8;     // the number of the pushbutton pin
const int ledtwohz =  7;      // the number of the LED pin
const int ledonehz = 6;
const int ledhalfhz = 5;
const int ledquarterhz = 4;
const int ledfivequartershz = 9;
int counter = 0;

// variables will change:
boolean buttonState = 0;         // variable for reading the pushbutton status
boolean prevButtonState = 0;

const uint16_t sineonehzlength = 1000;
const uint16_t sinetwohzlength = 500;
const uint16_t sinehalfhzlength = 2000;
const uint16_t sinequarterhzlength = 4000;
const uint16_t sinefivequartershzlength = 800;

int sinefivequartershz[sinefivequartershzlength] = {
  2048, 2064, 2080, 2096,
  2112, 2128, 2144, 2160,
  2176, 2192, 2208, 2224,
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  1983, 1999, 2015, 2031
};

int sinetwohz[sinetwohzlength] = {
2048, 2073, 2099, 2125,
2150, 2176, 2202, 2227,
2253, 2279, 2304, 2330,
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1945, 1970, 1996, 2022,
};

int sineonehz[sineonehzlength] = {
2048, 2060, 2073, 2086,
2099, 2112, 2125, 2138,
2150, 2163, 2176, 2189,
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1996, 2009, 2022, 2035,
};

int sinequarterhz[sinequarterhzlength] = {
2048, 2051, 2054, 2057,
2060, 2064, 2067, 2070,
2073, 2076, 2080, 2083,
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2035, 2038, 2041, 2044,
};

int sinehalfhz[sinehalfhzlength] = {
2048, 2054, 2060, 2067,
2073, 2080, 2086, 2093,
2099, 2105, 2112, 2118,
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2022, 2028, 2035, 2041,
};

uint16_t samplecounter = 0;
uint8_t cyclecounter = 0;
uint8_t whichsine = 0;

void writeSinusoid()
{
  if (counter == 0){ // two hz
    volt_write = sinetwohz[samplecounter];
    samplecounter = (++samplecounter % sinetwohzlength);
  }
  else if (counter == 1){ // five quarters hz
    volt_write = sinefivequartershz[samplecounter];
    samplecounter = (++samplecounter % sinefivequartershzlength);
  }
  else if (counter == 2){ // one hz
    volt_write = sineonehz[samplecounter];
    samplecounter = (++samplecounter % sineonehzlength);
  }
  else if (counter == 3){ // half hz
    volt_write = sinehalfhz[samplecounter];
    samplecounter = (++samplecounter % sinehalfhzlength);
    }
  else if (counter == 4){ // quarter hz
    volt_write = sinequarterhz[samplecounter];
    samplecounter = (++samplecounter % sinequarterhzlength);
  }

  Wire.beginTransmission(MCP4725_ADDR);
  Wire.write(64);
  Wire.write(volt_write >> 4);
  Wire.write((volt_write & 15) << 4);
  Wire.endTransmission();

}

boolean debounce(boolean last){
  boolean current = digitalRead(buttonPin);
  if (last != current){
    delay(125);
    current= digitalRead(buttonPin);
  }
  return current;
}

void changeLed(int cnt){
  if (cnt == 0){
    digitalWrite(ledtwohz, HIGH);
    digitalWrite(ledfivequartershz, LOW);
    digitalWrite(ledonehz, LOW);
    digitalWrite(ledhalfhz, LOW);
    digitalWrite(ledquarterhz, LOW);
  }
  else if (cnt == 1){
    digitalWrite(ledtwohz, LOW);
    digitalWrite(ledfivequartershz, HIGH);
    digitalWrite(ledonehz, LOW);
    digitalWrite(ledhalfhz, LOW);
    digitalWrite(ledquarterhz, LOW);
  }
  else if (cnt == 2){
    digitalWrite(ledtwohz, LOW);
    digitalWrite(ledfivequartershz, LOW);
    digitalWrite(ledonehz, HIGH);
    digitalWrite(ledhalfhz, LOW);
    digitalWrite(ledquarterhz, LOW);
  }
  else if (cnt == 3){
    digitalWrite(ledtwohz, LOW);
    digitalWrite(ledfivequartershz, LOW);
    digitalWrite(ledonehz, LOW);
    digitalWrite(ledhalfhz, HIGH);
    digitalWrite(ledquarterhz, LOW);
  }
  else if (cnt = 4){
    digitalWrite(ledtwohz, LOW);
    digitalWrite(ledfivequartershz, LOW);
    digitalWrite(ledonehz, LOW);
    digitalWrite(ledhalfhz, LOW);
    digitalWrite(ledquarterhz, HIGH);
  }
  else{
    digitalWrite(ledtwohz, LOW);
    digitalWrite(ledfivequartershz, LOW);
    digitalWrite(ledonehz, LOW);
    digitalWrite(ledhalfhz, LOW);
    digitalWrite(ledquarterhz, LOW);
  }
}

void setup()
{

  // initialize the LED pin as an output:
  pinMode(ledtwohz, OUTPUT);
  pinMode(ledonehz, OUTPUT);
  pinMode(ledhalfhz, OUTPUT);
  pinMode(ledquarterhz, OUTPUT);
  pinMode(ledfivequartershz, OUTPUT);
  // initialize the pushbutton pin as an input:
  pinMode(buttonPin, INPUT);

  // Setup I2C Connection for MCP4725 Device
  Wire.begin();

  //Setup interrupt
  uint32_t interruptTime = round(Ts*1000000);
  Timer3.attachInterrupt(writeSinusoid);
  Timer3.setFrequency(freq);
  Timer3.start();

}

void loop()
{
  // read the state of the pushbutton value:
  buttonState = debounce(prevButtonState);

  // check if the pushbutton is pressed. If it is, the buttonState is HIGH:
  if (prevButtonState == LOW && buttonState == HIGH) {
    counter = (++counter % 5);
    changeLed(counter);
  }
}
